  #include <Keypad.h>
#include <LedControl.h>

//ledmatrix
int DIN = 12;
int CS = 11;
int CLK = 10;

//keypad
const byte numRows= 4;
const byte numCols= 4;
char keymap[numRows][numCols]= 
{
{'4', '8', 'B', 'F'}, 
{'3', '7', 'A', 'E'}, 
{'2', '6', '0', 'D'},
{'1', '5', '9', 'C'}
};

byte rowPins[numRows] = {9,8,7,6};
byte colPins[numCols]= {5,4,3,2};

LedControl lc = LedControl(DIN,CLK,CS,0);
Keypad myKeypad = Keypad(makeKeymap(keymap), rowPins, colPins, numRows, numCols);

byte zero[8] = {0x7c,0x44,0x44,0x44,0x44,0x44,0x44,0x7c};
byte one[8] = {0x10,0x30,0x50,0x10,0x10,0x10,0x10,0x7c};
byte two[8] = {0x7c,0x04,0x04,0x7c,0x40,0x40,0x40,0x7c};
byte three[8] = {0x7c,0x04,0x04,0x3c,0x04,0x04,0x04,0x7c};
byte four[8] = {0x44,0x44,0x44,0x44,0x7c,0x04,0x04,0x04};
byte five[8] = {0x7c,0x40,0x40,0x40,0x7c,0x04,0x04,0x7c}; 
byte six[8] = {0x7c,0x40,0x40,0x40,0x7c,0x44,0x44,0x7c};
byte seven[8] = {0x7c,0x04,0x04,0x04,0x04,0x04,0x04,0x04};
byte eight[8] = {0x7c,0x44,0x44,0x44,0x7c,0x44,0x44,0x7c};
byte nine[8] = {0x7c,0x44,0x44,0x44,0x7c,0x04,0x04,0x7c};
byte a[8] = {0x7c,0x44,0x44,0x44,0x7c,0x44,0x44,0x44};
byte b[8] = {0x78,0x44,0x44,0x78,0x44,0x44,0x44,0x78};
byte c[8] = {0x7c,0x40,0x40,0x40,0x40,0x40,0x40,0x7c};
byte d[8] = {0x78,0x44,0x44,0x44,0x44,0x44,0x44,0x78};
byte e[8] = {0x7c,0x40,0x40,0x78,0x40,0x40,0x40,0x7c};
byte f[8] = {0x7c,0x40,0x40,0x78,0x40,0x40,0x40,0x40};


void printByte(byte character [])
{
  int i = 0;
  for(i=0;i<8;i++)
  {
    lc.setRow(0,i,character[i]);
  }
}

void setup() {
 ///ledmatrix
 lc.shutdown(0,false);
 lc.setIntensity(0,15);
 lc.clearDisplay(0);
 ///keypad matrix
 Serial.begin(9600);
}

void loop() {
  char keypressed = myKeypad.getKey();
 if (keypressed != NO_KEY)
 {
    Serial.print(keypressed);
    switch (keypressed) {
      case '0': printByte(zero); break; 
      case '1': printByte(one); break;
      case '2': printByte(two); break;
      case '3': printByte(three); break;
      case '4': printByte(four); break;
      case '5': printByte(five); break;
      case '6': printByte(six); break;
      case '7': printByte(seven); break;
      case '8': printByte(eight); break;
      case '9': printByte(nine); break;
      case 'A': printByte(a); break;
      case 'B': printByte(b); break;
      case 'C': printByte(c); break;
      case 'D': printByte(d); break;
      case 'E': printByte(e); break;
      case 'F': printByte(f); break;
      default :
        break;
    }
 }
}
